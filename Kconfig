## Kconfig
```kconfig
menu "HAGL HAL for SSD1353"


config SSD1353_WIDTH
    int "Display width in pixels"
    default 160

config SSD1353_HEIGHT
    int "Display height in pixels"
    default 128

config SSD1353_PIN_MOSI
    int "MOSI pin number"
    default 14

config SSD1353_PIN_CLK
    int "CLK pin number"
    default 4

config SSD1353_PIN_CS
    int "CS pin number"
    default 2

config SSD1353_PIN_DC
    int "DC pin number"
    default 12

config SSD1353_PIN_RST
    int "RST pin number"
    default 15

endmenu
```
